## zephyr/dts/bindings/gpio-column.yml
```yaml
description: GPIO pins to switch power to columns of the matrix
compatible: "gpio-columns"

child-binding:
  description: GPIO Columns child node
  properties:
    gpios:
      type: phandle-array
      required: true
      description: |
        The GPIO pin representing a column in the matrix.
    label:
      type: string
      required: true
      description: A label
```

## zephyr/dts/bindings/gpio-row.yml
```yaml
description: GPIO pins to read activated rows in the matrix
compatible: "gpio-rows"

child-binding:
  description: GPIO Rows child node
  properties:
    gpios:
      type: phandle-array
      required: true
      description: |
        The GPIO pin representing a row in the matrix.
    label:
      type: string
      required: true
      description: A label
```

## zephyr/dts/bindings/rhs-register.yml
```yaml
description: Right Hand Side I2C Register

compatible: "rhs-register"

include: i2c-device.yaml
```
